## sdkconfig.defaults
```kconfig
CONFIG_IDF_TARGET="esp32c3"

# USB Serial JTAG - cho ESP32-C3 ket noi USB
CONFIG_ESP_CONSOLE_USB_SERIAL_JTAG=y

# HTTPS (API nhiet do)
CONFIG_MBEDTLS_CERTIFICATE_BUNDLE=y
CONFIG_MBEDTLS_CERTIFICATE_BUNDLE_DEFAULT_CMN=y

# Partition table co storage (SPIFFS) cho log
CONFIG_PARTITION_TABLE_CUSTOM=y
CONFIG_PARTITION_TABLE_CUSTOM_FILENAME="partitions.csv"
```
